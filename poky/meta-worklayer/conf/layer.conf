## poky/meta-worklayer/conf/layer.conf
```bitbake
# We have a conf and classes directory, add to BBPATH
BBPATH .= ":${LAYERDIR}"

# We have recipes-* directories, add to BBFILES
BBFILES += "${LAYERDIR}/recipes-*/*/*.bb \
            ${LAYERDIR}/recipes-*/*/*.bbappend"

BBFILE_COLLECTIONS += "meta-worklayer"
BBFILE_PATTERN_meta-worklayer = "^${LAYERDIR}/"
BBFILE_PRIORITY_meta-worklayer = "6"

LAYERDEPENDS_meta-worklayer = "core"
LAYERSERIES_COMPAT_meta-worklayer = "scarthgap"
```
